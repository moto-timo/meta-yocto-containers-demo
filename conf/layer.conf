## conf/layer.conf
```bitbake
# We have a conf and classes directory, add to BBPATH
BBPATH .= ":${LAYERDIR}"

# We have recipes-* directories, add to BBFILES
BBFILES += "${LAYERDIR}/recipes-*/*/*.bb \
            ${LAYERDIR}/recipes-*/*/*.bbappend"

BBFILE_COLLECTIONS += "meta-yocto-containers-demo"
BBFILE_PATTERN_meta-yocto-containers-demo = "^${LAYERDIR}/"
BBFILE_PRIORITY_meta-yocto-containers-demo = "6"

LAYERDEPENDS_meta-yocto-containers-demo = "\
    core \
    openembedded-layer \
    filesystems-layer \
    networking-layer \
    meta-python \
    virtualization-layer \
    webserver \
"
LAYERSERIES_COMPAT_meta-yocto-containers-demo = "whinlatter"
```
